## ros2_motor_controller_idf/main/Kconfig.projbuild
```kconfig
menu "Motor controller settings"

config MOTOR_CONTROLLER_APP_STACK
    int "micro-ROS motor controller task stack (bytes)"
    default 16000

config MOTOR_CONTROLLER_APP_TASK_PRIO
    int "micro-ROS motor controller task priority"
    default 5

endmenu
```
